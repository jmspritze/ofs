/* Overland Flow Sensor Software 
 * Version 0.1
 * 
 * This software collects range data from two IR sensors and provides
 * latitude, longitude, and datetime information. The data is saved on 
 * a micro-SD card with datetime formated for SQL.
 * 
 * The minimum range of the IR sensor is 4 cm and maximum range is ~20cm.
 * Analog range values are converted to distance by the lookup table values
 * with the key:value pair is array index is the analog voltage, and the 
 * array value is the calibrated distance. The lookup tables are stored in 
 * the program memory of the Arduino.
 */

#include <avr/pgmspace.h>
#include <ctype.h>
#include <TinyGPS++.h>
#include <AltSoftSerial.h>
#include <SPI.h>
#include <SD.h>

//IR sensor analog pins
#define irSensorPin0   A0  
#define irSensorPin1   A2 
int irSensor0=0;
int irSensor1=0;

//GPS communiction setup
static const int RXPin = 8,TXPin = 9;
static const uint32_t GPSBaud = 38400;
TinyGPSPlus gps;                        // The TinyGPS++ object
AltSoftSerial ss(RXPin, TXPin);         // The serial connection to the GPS device

// set up variables using the SD utility library functions:
Sd2Card card;
SdVolume volume;
SdFile root;
const int chipSelect = 4;

//Sensor0 lookup Table
const int Sensor0[] PROGMEM = {255,
255,255,255,255,255,255,255,255,255,255,255,255,255,255,255,255,255,255,255,
255,255,255,255,255,255,255,255,255,255,255,255,255,255,255,255,255,255,255,
255,255,255,255,255,255,255,255,255,255,255,255,255,255,255,255,255,255,255,
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52,52,52,52,52,52,52,52,51,51,51,51,51,51,51,51,51,51,50,50,50,50,50,50,50};

const int Sensor1[] PROGMEM = {255,255,255,255,255,255,
255,255,255,255,255,255,255,255,255,255,255,255,255,255,255,255,255,255,
255,255,255,255,255,255,255,255,255,255,255,255,255,255,255,255,255,255,
255,255,255,255,255,255,255,255,255,255,255,255,255,255,255,255,255,255,
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52,52,52,52,52,52,52,51,51,51,51,51,51,51,51,51,51,50,50,50,50,50,50,50};

void setup() {
  Serial.begin(115200);
  ss.begin(GPSBaud);
  
  pinMode(10, OUTPUT);
   // see if the card is present and can be initialized:
  if (!SD.begin(chipSelect)) {
    Serial.println("Card failed, or not present");
    // don't do anything more:
    return;
  }
  Serial.println("card initialized.");
}

void loop() {
    File dataFile = SD.open("datalog.txt", FILE_WRITE);  
    irSensor0 = analogRead(irSensorPin0);
    irSensor1 = analogRead(irSensorPin1);


    irSensor0 = pgm_read_word(&Sensor0[irSensor0]);
    irSensor1 = pgm_read_word(&Sensor1[irSensor1]);    
    
  /***  Sensor output test ***
    Serial.print(irSensor0);
    Serial.print(",");
    Serial.println(irSensor2);
  */
     

    while (ss.available())
    {     
       if (gps.encode(ss.read()))
       {  
         /* dataFile.print(gps.date.year());
          dataFile.print("-");
          dataFile.print(gps.date.month());
          dataFile.print ("-"); 
          dataFile.print(gps.date.day());
          dataFile.print(" "); 
          dataFile.print(gps.time.hour());
          dataFile.print( ":");
          dataFile.print(gps.time.minute());
          dataFile.print(":");
          dataFile.print(gps.time.second());
          dataFile.print(",");
          dataFile.print(irSensor0);
          dataFile.print(",");
          dataFile.println(irSensor1);  
          dataFile.close(); */


          
/*** GPS output Test ***
    Serial.print(gps.date.year());
    Serial.print("-");
    Serial.print(gps.date.month());
    Serial.print ("-"); 
    Serial.print(gps.date.day());
    Serial.print(" "); 
    Serial.print(gps.time.hour());
    Serial.print( ":");
    Serial.print(gps.time.minute());
    Serial.print(":");
    Serial.println(gps.time.second());
    */
     }
    //delay(500);
   } 
}

